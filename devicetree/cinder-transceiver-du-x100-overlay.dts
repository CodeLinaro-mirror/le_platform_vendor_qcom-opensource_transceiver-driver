// SPDX-License-Identifier: GPL-2.0-only
/*
 * Copyright (c) 2022 Qualcomm Innovation Center, Inc. All rights reserved.
 */
/dts-v1/;
/plugin/;

#include "cinder-transceiver-du-x100.dtsi"

/ {
	model = "Qualcomm Technologies, Inc. Cinder ECPRI";
	compatible = "qcom,cinder-ecpri", "qcom,ecpri", "qcom,cinder";
	qcom,msm-id = <545 0x10000>;
	qcom,board-id = <0x27 0x0>;
};
